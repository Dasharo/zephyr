## drivers/spi/Kconfig.neorv32
```kconfig
config SPI_NEORV32
	bool "NeoRV32 SPI controller driver"
	default y
	depends on DT_HAS_NEORV32_SPI_ENABLED
```

## dts/bindings/spi/neorv32-spi.yaml
```yaml
description: NeoRV32 SPI controller
compatible: "neorv32-spi"
include: "spi-controller.yaml"

properties:
  reg:
    required: true

  syscon:
    type: phandle
    required: true
    description: |
      phandle to syscon (NEORV32 SYSINFO) node.
```
